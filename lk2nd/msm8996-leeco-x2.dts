// SPDX-License-Identifier: BSD-3-Clause
/*
 * LeEco Le Max 2 (x2 / LEX820)
 *
 * Board ids read from the live device's /proc/device-tree:
 *   qcom,msm-id   = <246 0x30001>
 *   qcom,board-id = <8 0x2e>
 *   qcom,pmic-id  = <0x20009 0x10013 0x00 0x00>
 *
 * Note: pmic-id is identical to h850 / oneplus3 / scorpio upstream lk2nd
 * devicetrees, so it is known-good.
 */

/dts-v1/;

#include <skeleton64.dtsi>
#include <lk2nd.dtsi>

/ {
	qcom,msm-id = <246 0x30001>;
	qcom,board-id = <8 0x2e>;
	qcom,pmic-id = <0x20009 0x10013 0x00 0x00>;
};

&lk2nd {
	model = "LeEco Le Max 2";
	compatible = "leeco,x2";

	gpio-keys {
		compatible = "gpio-keys";

		volume-up {
			lk2nd,code = <KEY_VOLUMEUP>;
			/* vendor mtp-le-common.dtsi:710 - vol_up is pm8994 gpio2.
			 * gpio3 was wrong: it floats low on x2, so lk2nd saw
			 * "volume up pressed" at every boot and force-booted the
			 * recovery partition instead of the passed kernel. */
			gpios = <&pmic 2 GPIO_ACTIVE_LOW>;
		};

		/* x2 has no second gpio volume key (vol-down is the resin
		 * power-on key), so nothing else to map here. */
	};
};
